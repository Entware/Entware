## package/libs/libpcap/Config.in
```kconfig
menu "Configuration"
	depends on PACKAGE_libpcap

config PCAP_HAS_USB
	bool "Include USB support"
	depends on PACKAGE_kmod-usb-core
	default n

config PCAP_HAS_BT
	bool "Include bluetooth support"
	depends on PACKAGE_kmod-bluetooth
	depends on BROKEN
	default n

config PCAP_HAS_NETFILTER
	bool "Include netfilter support"
	default n

endmenu
```

## toolchain/binutils/Config.in
```kconfig
# Choose binutils version.

choice
	prompt "Binutils Version" if TOOLCHAINOPTS
	default BINUTILS_USE_VERSION_2_30
	help
	  Select the version of binutils you wish to use.

	config BINUTILS_USE_VERSION_2_26_1
		bool "Binutils 2.26.1"

	config BINUTILS_USE_VERSION_2_27
		bool "Binutils 2.27"

	config BINUTILS_USE_VERSION_2_29_1
		bool "Binutils 2.29.1"

	config BINUTILS_USE_VERSION_2_30
		bool "Binutils 2.30"

endchoice

config EXTRA_BINUTILS_CONFIG_OPTIONS
	string
	prompt "Additional binutils configure options" if TOOLCHAINOPTS
	default ""
	help
	    Any additional binutils options you may want to include....
```

## toolchain/gcc/Config.in
```kconfig
# Choose gcc version.

choice
	prompt "GCC compiler Version" if TOOLCHAINOPTS
	default GCC_USE_VERSION_5_4_0
	help
	  Select the version of gcc you wish to use.

	config GCC_USE_VERSION_5_4_0
		select GCC_VERSION_5_4_0
		bool "gcc 5.4.0"

	config GCC_USE_VERSION_6_3_0
		select GCC_VERSION_6_3_0
		bool "gcc 6.3.0"

endchoice

config GCC_USE_GRAPHITE
	depends on !GCC_VERSION_4_8_ARC
	bool
	prompt "Compile in support for the new Graphite framework in GCC 4.4+" if TOOLCHAINOPTS

config EXTRA_GCC_CONFIG_OPTIONS
	string
	prompt "Additional gcc configure options" if TOOLCHAINOPTS
	default ""
	help
	    Any additional gcc options you may want to include....

config SSP_SUPPORT
	bool
	prompt "Enable Stack-Smashing Protection support" if TOOLCHAINOPTS
	help
	    Enable Stack-Smashing Protection support

config SJLJ_EXCEPTIONS
	bool
	prompt "Use setjump()/longjump() exceptions" if TOOLCHAINOPTS
	default n
	help
	    Use old setjump()/longjump() exceptions instead of the newer
	    frame unwinding exceptions handling routines.  Warning: increases
	    code size and runtime memory usage.

config INSTALL_LIBGCJ
	bool
	prompt "Build/install java compiler and GNU classpath ?" if TOOLCHAINOPTS
	default n
	help
	    Build/install java compiler and GNU classpath ?


config INSTALL_GFORTRAN
	bool
	prompt "Build/install fortran compiler?" if TOOLCHAINOPTS
	default n
	help
	    Build/install GNU fortran compiler ?

config INSTALL_GCCGO
	bool
	prompt "Build/install gccgo compiler?" if TOOLCHAINOPTS && !(GCC_VERSION_4_6 || GCC_VERSION_4_6_LINARO)
	default n
	help
	    Build/install GNU gccgo compiler ?
```

## toolchain/uClibc/Config.in
```kconfig
# Choose uclibc version.

choice
	prompt "uClibc Version"
	depends on TOOLCHAINOPTS && USE_UCLIBC
	default UCLIBC_USE_VERSION_NG
	help
	  Select the version of uClibc you wish to use.

	config UCLIBC_USE_VERSION_NG
		select UCLIBC_VERSION_NG
		bool "uClibc-ng"

endchoice

# Debug version.

config UCLIBC_ENABLE_DEBUG
	bool "Build with debug information"
	depends on TOOLCHAINOPTS && USE_UCLIBC
	default n
```
